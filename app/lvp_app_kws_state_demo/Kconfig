## lvp/common/Kconfig
```kconfig
#
# Grus
# Copyright (C) 2001-2023 NationalChip Co., Ltd
# ALL RIGHTS RESERVED!
#
# Kconfig: Common function Kconfig
#---------------------------------------------------------------------------------#

menu "Common Function Settings"

#---------------------------------------------------------------------------------#
    menuconfig LVP_HAS_UART_MESSAGE_2_0
        bool "Has Uart protocol Message2.0"
        default y
        help
            If you need Uart Message2.0, say Y here!

    if LVP_HAS_UART_MESSAGE_2_0
        choice
            prompt "Select Uart port for protocol:"
            default UART_MESSAGE_PORT_BOTH

            config UART_MESSAGE_PORT_0
            bool "Uart 0"

            config UART_MESSAGE_PORT_1
            bool "Uart 1"

            config UART_MESSAGE_PORT_BOTH
            bool "Both Uart 0 and Uart 1"

        endchoice

        config LVP_UART_MESSAGE_SEND_Q_LEN
            int "Send Queue Length"
            default 8

        config LVP_UART_MESSAGE_RECV_Q_LEN
            int "Recv Queue Length"
            default 8

        config LVP_UART_MESSAGE_SEND_REGIST_NUM
            int "The num of Rend callback registed"
            default 6

        config LVP_UART_MESSAGE_RECV_REGIST_NUM
            int "The num of Recv callback registed"
            default 16
    endif


    menuconfig LVP_HAS_UART_RECORD
        bool "Has Uart Record"
        default y
        help
            If the board you choose can record by uart, say Y here!

    if LVP_HAS_UART_RECORD
        config LVP_UART_RECORD_PORT
            int "Uart port"
            default 0

        config LVP_UART_RECORD_PORT_BAUDRATE
            int "Uart baudrate"
            default 500000

        config LVP_ENABLE_G_SENSOR_RECORD
            bool "Enable g_sensor data record"
            depends on LVP_HAS_G_SENSOR_DEVICE
            default n
    endif

    config UART_RECORD_ENABLE
        bool "Enable uart record"
        select LVP_HAS_UART_RECORD
        default 0

    menuconfig LVP_HAS_VOICE_PLAYER
        bool "Has voice player"
        default n
        help
          If you need voice player workmode, say Y here!

    if LVP_HAS_VOICE_PLAYER
        config LVP_HAS_VOICE_PLAYER_SLAVE_MODE
            bool "default MASTER mode, if you need SLAVE mode, say Y here"
            default n
    choice
        prompt "select audio decoder"
        default USE_OPUS
        config USE_NO_DECODER
            bool "use no decoder"

        config USE_OPUS
            bool "use opus decoder"

        config USE_AMR
            bool "use amr decoder"

        config USE_ADPCM
            bool "use adpcm decoder"

    endchoice
        source "3rdparty/opus/Kconfig"

        choice
            prompt "dac channel select"
            default VOICE_PLAYER_DAC_STEREO
            config VOICE_PLAYER_DAC_STEREO
                bool "stereo"
            config VOICE_PLAYER_DAC_LEFT
                bool "left"
            config VOICE_PLAYER_DAC_RIGHT
                bool "right"
            config VOICE_PLAYER_DAC_MONO
                bool "mono"
        endchoice
    endif

    menuconfig LVP_HAS_RESOURCE_BIN
        bool "Resource Bin Settings"
        default n

    if LVP_HAS_RESOURCE_BIN
        config RESOURCE_BIN_ADDRESS_IN_FLASH
            int "Resource Bin Address In Flash"
            default 884736

        menuconfig CUSTOM_STORAGE_SPACE
            bool "Custom Storage Space Settings"
            default n

        config CUSTOM_STORAGE_SPACE_LEN
            int "Custom space size (unit: 4K)"
            default 2 if ENABLE_CLOSE_CMD_RECOGNIZE && NEED_WRITE_FLASH_CLOSE_KV_NUM != 0 && ENABLE_STORAGE_CUSTOM_DATA
            default 1
            range 2 256 if ENABLE_CLOSE_CMD_RECOGNIZE && NEED_WRITE_FLASH_CLOSE_KV_NUM != 0 && ENABLE_STORAGE_CUSTOM_DATA
            range 1 256
            depends on CUSTOM_STORAGE_SPACE
            help
            This option sets the size of the custom storage space in units of 4K.
            When ENABLE_STORAGE_CUSTOM_DATA is enabled, the default value is 2 and the minimum value is 2.
            Otherwise, the default value is 1.

        config ENABLE_STORAGE_CUSTOM_DATA
            bool "Enable Custom Data Storage"
            default n
            depends on CUSTOM_STORAGE_SPACE

        config ENABLE_CLOSE_CMD_RECOGNIZE
            bool "Enable Close Command Recognize"
            default n
            depends on CUSTOM_STORAGE_SPACE

        if ENABLE_CLOSE_CMD_RECOGNIZE
        config NEED_WRITE_FLASH_CLOSE_KV_NUM
            int "the number of writes to flash required"
            default 20

        config NO_NEED_WRITE_FLASH_CLOSE_KV_NUM
            int "the number of writes to flash not required"
            default 20
        endif

    endif

    menuconfig LVP_SELF_LEARNING_ENABLE
        bool "Self Learning Settings"
        default n

    if LVP_SELF_LEARNING_ENABLE
        config LVP_SELF_LEARN_REPETITION_COUNT
            int "Set the number of self-learning repetition count"
            default 3

        config LVP_SELF_LEARN_WAKE_WORD_NUM
            int "Set the number of self-learning wake words"
            default 1

        config LVP_SELF_LEARN_INSTRUCTION_WORD_NUM
            int "Set the number of self-learning instruction words"
            default 5

        config LVP_SELF_LEARN_IMMEDIATE_WORD_NUM
            int "Set the number of self-learning immediate words"
            default 0

        config LVP_MUTE_NUM
            int "Set mute how long you think to stop talking[unit:context]"
            default 4

        config LVP_SELF_LEARN_UES_LED_TIP
            bool "Use led Tips"
            default n

        if LVP_SELF_LEARN_UES_LED_TIP
            config LVP_SELF_LEARN_LED_PIN_ID
                int "Self Learn LED GPIO"
                default 1
        endif
    endif

    menuconfig LVP_HAS_KWS_UART_REPORT
        bool "Uart Active Reporting Settings"
        select LVP_HAS_RESOURCE_BIN
        default n

    if LVP_HAS_KWS_UART_REPORT
        config KWS_UART_REPORT_UART
            int "Set the uart to use"
            default 0
            range 0 1

        config KWS_UART_REPORT_UART_BAUDRATE
            int "Set the baudrate to use"
            default 9600

        config KWS_UART_REPORT_CMD_DATA_LEN
            int "Set the length of the data"
            default 4

        config KWS_UART_REPORT_CMD_TIMES
            int "Set the number of retransmissions"
            default 1
            range 1 100
            help
                The value is at least one.

        config KWS_UART_REPORT_CMD_INTERVAL
            int "Set the retransmission interval"
            default 100
            depends on KWS_UART_REPORT_CMD_TIMES != 1
    endif

    menuconfig LVP_HAS_TTS_PLAYER
        bool "TTS Player Settings(You Can Only Choose 'Has voice player')"
        select LVP_HAS_RESOURCE_BIN
        default n

    if LVP_HAS_TTS_PLAYER
        config LVP_PLAYER_MUTE_PIN
            int "Mute Pin"
            default 2

        config LVP_PLAYER_MUTE_PIN_LEVEL_STATUS
            int "Mute Pin Level Status"
            default 0
            range 0 1

        menuconfig LVP_HAS_UART_TTS_REPLY_PLAYER
            bool "Has Uart TTS Reply Player"
            default n
            help
                If you want to turn on the serial tts reply play, say Y here!

        if LVP_HAS_UART_TTS_REPLY_PLAYER
            choice
                prompt "Set the broadcast response mode"
                default PLAYER_UART_INTERRUPT_MODE

                config PLAYER_UART_INTERRUPT_MODE
                    bool "Interrupt mode"
                    help
                      This transmission interrupts the last broadcast

                config PLAYER_UART_NO_INTERRUPT_MODE
                    bool "In non-interrupt mode"
                    help
                      This transmission cannot interrupt the last broadcast
            endchoice

            config PLAYER_UART_SAME_EVENT_TRIGGER_INTERVAL
                int "The minimum interval at which the same event is triggered is invalid(unit:ms)"
                default 0

            config REPLY_PLAYER_UART_CMD_DATA_LEN
                int "Set the length of the serial port command"
                default 4

            config REPLY_PLAYER_UART
                int "Set the serial port to use"
                default 0
                range 0 1

            config REPLY_PLAYER_UART_BAUDRATE
                int "Set the baudrate to use"
                default 9600

        endif
    endif


    menuconfig ENABLE_CACULATE_STANDBY_RATIO
        bool "Enable Caculate Standby Ratio"
        default n

    if ENABLE_CACULATE_STANDBY_RATIO
        config CACULATE_STANDBY_RATIO_WINDOW_LENGTH
            int "Standby Ratio Window Length (Second)"
            default 60
        config CACULATE_STANDBY_RATIO_UPDATE_FREQUENCY
            int "Update The Frequency Of Caculate Standby Ratio (Second)"
            default 4
        config CACULATE_STANDBY_RATIO_THRESHOLD
            int "Standby Ratio Threshold (x1000)"
            default 100
            help
                You can use this threshold to do what you want, such as judging whether it is a high noisy environment
    endif

    menuconfig LVP_HAS_WATCHDOG
        bool "Has watchdog"
        default n
        help
          If you need watchdog, say Y here!

    if LVP_HAS_WATCHDOG

        config LVP_HAS_WATCHDOG_RESET_MS
            int "Reset Time (ms)"
            default 3000

        config LVP_HAS_WATCHDOG_TIMEOUT_MS
            int "Time Out IRQ (ms)"
            default 2999

        config LVP_HAS_WATCHDOG_TICK_BLOCK
            bool "Reset when tick block"
            default y
            help
                If say no, will reset when IRQ block.

    endif

    menuconfig LVP_HAS_UART_LOADER
        bool "Has uart loader"
        default n

    if LVP_HAS_UART_LOADER
        config ENABLE_PRINT_SEND_RECV_INFO
            bool "Enable to print send and receive data information"
            default n

        config ENABLE_RECV_8303_UART_DATA
            bool "The 8303 serial port printing function was enabled"
            default n
    endif
endmenu

#---------------------------------------------------------------------------------#
```

## lvp/vui/Kconfig
```kconfig
#
# Grus
# Copyright (C) 2001-2023 NationalChip Co., Ltd
# ALL RIGHTS RESERVED!
#
# Kconfig: Gurs Kconfig
#---------------------------------------------------------------------------------#

menu "VUI Settings"

#--------------------------------------------#
    comment "VAD Settings:"
    config LVP_FFT_VAD_ENABLE
        bool "Enable FFT Vad"
        default n
    config LVP_FFT_INVALID_VAD_NUM
        int "Number of invalid vad, use for filter invalid vad, unit by context"
        default 25
        depends on LVP_FFT_VAD_ENABLE
    config LVP_ENABLE_AUTO_ADJUST_VAD_PARAMETER
        bool "Enable Auto Adjust VAD Parameter"
        depends on LVP_FFT_VAD_ENABLE
        default n

    comment ""

    comment "ENV Noise Judgment Settings:"
    config ENABLE_NOISE_JUDGEMENT
        bool "Enable Noise Judgment"
        default n
    config HIGH_NOISE_MAINTAIN_TIME
        int "High Noise Maintain Time [unit of context]"
        depends on ENABLE_NOISE_JUDGEMENT
        default 150
    config MID_NOISE_MAINTAIN_TIME
        int "Mid Noise Maintain Time [unit of context]"
        depends on ENABLE_NOISE_JUDGEMENT
        default 50
    config LOW_NOISE_MAINTAIN_TIME
        int "Low Noise Maintain Time [unit of context]"
        depends on ENABLE_NOISE_JUDGEMENT
        default 150

    comment ""

    config LVP_STANDBY_ENABLE
        bool "Enable Standby"
        default n
    config LVP_DISABLE_XIP_WHILE_CODE_RUN_AT_SRAM
        depends on LVP_STANDBY_ENABLE
        bool "Disable XIP While Code Run At Sram"
        default n
    config LVP_STATE_FVAD_COUNT_DOWN
        int "LVP State Fvad count down, use for switch State Fvad to Standby,unit by context"
        depends on LVP_STANDBY_ENABLE
        default 9

    comment ""

    config LVP_ENABLE_KEYWORD_RECOGNITION
        bool "Enable Keyword Recognition"
        default y
    if LVP_ENABLE_KEYWORD_RECOGNITION
        source "lvp/vui/kws/Kconfig"
    endif


endmenu

#---------------------------------------------------------------------------------#
```

## lvp/vui/kws/Kconfig
```kconfig
#
# Grus
# Copyright (C) 2001-2023 NationalChip Co., Ltd
# ALL RIGHTS RESERVED!
#
# Kconfig: Gurs Kconfig
#---------------------------------------------------------------------------------#

# Public Model Values
config KWS_SNPU_BUFFER_SIZE
    int

config KWS_MODEL_FEATURES_DIM_PER_FRAME
    int

config KWS_MODEL_INPUT_STRIDE_LENGTH
    int

config KWS_MODEL_INPUT_WIN_LENGTH
    int

config KWS_MODEL_OUTPUT_LENGTH
    int

config KWS_MODEL_SUPPORT_SOFTMAX
    bool

config KWS_MODEL_BEAMSEARCH_AND_LM_ALPHA
    int

config KWS_MODEL_BEAMSEARCH_AND_LM_BETA
    int

config KWS_MODEL_BEAMSEARCH_AND_LM_CUTOFF_TOP_N
    int

config BEAM_SIZE
    int

config PREFIX_CHAR_LENGTH
    int

config LEVENSHTEIN_THRESHOLD
    int

config DIMSIM_THRESHOLD
    int

config NORMAL_CTC_SCORE
    bool

config NPU_TOTAL_SIZE
    int

#---------------------------------------------------------------------------------#

choice
    prompt "Keyword Decoder Type"
    default LVP_ENABLE_CTC_GX_DECODER

    config LVP_ENABLE_CTC_GX_DECODER
        bool "CTC GX Deocder"
    config LVP_ENABLE_USER_DECODER
        bool "User Deocder"

endchoice

if LVP_ENABLE_CTC_GX_DECODER
    config ENABLE_USED_FOR_ALL_GRUS_FAMILY
        bool "Enable Used For All Grus Family"
        default y
    config ENABLE_DO_NOT_SLEEP_WHEN_AT_WAKE_UP
        bool "Enable Do not sleep when at wake up"
        default y
    config ENABLE_SWITCH_NPU_MODEL_RUN_IN_FLASH_OR_SRAM
        bool "Enable Switch Npu Model Run In Flash Or Sram"
        default n
    config ENABLE_PRINTF_GXDECODER_MEMORY_MONITORING
        bool "Enable GXdecoder Memory Monitoring"
        default n
    config BLANK_THRESHOLD_FOR_CTC_GX_DECODER
        int "Blank Threshold For CTC GX Decoder(x1000)"
        default 900
    source "lvp/vui/kws/gxdecoder/Kconfig"
    comment ""
    config ENABLE_FAST_DECODER
        bool "Enable Fast Decoder"
        default n
    config FAST_DECODER_SKIP_INVALID_CONTEXT
        depends on ENABLE_FAST_DECODER
        int "Skip Invalid Context Number"
        default 6
    comment ""        
endif

source "lvp/vui/kws/models/Kconfig"



#---------------------------------------------------------------------------------#
```

## lvp/vui/kws/gxdecoder/Kconfig
```kconfig
choice
    prompt "gxdecoder language model select:"
    default LVP_MODEL_FST_KUQI_FAN

    source "lvp/vui/kws/gxdecoder/model_fst/*/fst_version.name"

endchoice
```
