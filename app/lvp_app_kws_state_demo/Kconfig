## lvp/vui/kws/models/Kconfig
```kconfig
# Voice Signal Preprocess
# Copyright (C) 2001-2019 NationalChip Co., Ltd
# ALL RIGHTS RESERVED!
#
# Kconfig: KWS Kconfig
#---------------------------------------------------------------------------------#

choice
    prompt "KeyWord select:"
    default LVP_KWS_GENERAL_ASR_HOTATA_DRYER

    source "lvp/vui/kws/models/*/kws.name"
endchoice

# kws version list
source "lvp/vui/kws/models/*/kws_version.list"
# kws model param kconfig
source "lvp/vui/kws/models/*/*/Kconfig"
# kws list
source "lvp/vui/kws/models/*/*/kws.list"



config LVP_MODEL_USE_RNN
    bool "Model Use Recurrent Neural Network"
    default y

config LVP_ENABLE_CTC_BIONIC
    bool "Enable CTC BIONIC To Reduce False Activation"
    default n
    depends on LVP_ENABLE_CTC_GX_DECODER
config LVP_KWS_THRESHOLD_STEP
    int "[CTC] Threshold Step For Bionic(x10)"
    depends on LVP_ENABLE_CTC_BIONIC
    default 5
config LVP_KWS_MAX_THRESHOLD_ADJUSTMENT_VALUE
    int "[CTC] Maximum Threshold Adjustment Value For Bionic(x10)"
    depends on LVP_ENABLE_CTC_BIONIC
    default 20
config LVP_KWS_THRESHOLD_ADJUST_TIME
    int "[CTC] Threshold Adjust time For Bionic(Second)"
    depends on LVP_ENABLE_CTC_BIONIC
    default 500

#---------------------------------------------------------------------------------#
```

## lvp/vui/kws/models/viva_general_asr_v103_v055/v1.0.3_v0.5.5/Kconfig
```kconfig
menu "Model Param Setting:"
    depends on LVP_KWS_VIVA_GENERAL_ASR_V103_V055_V1DOT0DOT3_V0DOT5DOT5_2024_1105
    config NORMAL_CTC_SCORE
      default y

    config KWS_MODEL_SUPPORT_SOFTMAX
      default y
    # Byte
    config KWS_SNPU_BUFFER_SIZE
        default 6028

    # Frames
    config KWS_MODEL_FEATURES_DIM_PER_FRAME
        default 40

    config KWS_MODEL_INPUT_STRIDE_LENGTH
        default 6

    config KWS_MODEL_INPUT_WIN_LENGTH
        default 25

    config KWS_MODEL_OUTPUT_LENGTH
        default 191

    config KWS_MODEL_DECODER_STRIDE_LENGTH
        int "KWS Lantency (unit of Context)"
        default 1
        range 1 4

    config KWS_MODEL_DECODER_WIN_LENGTH
        int "KWS Model Decoder Window Length (unit of context)"
        default 21
endmenu
```

## lvp/vui/kws/models/viva_general_dryer_demo/drying_rack_exclusive_model_v5.0.4/Kconfig
```kconfig
menu "Model Param Setting:"
    depends on LVP_KWS_VIVA_GENERAL_DRYER_DEMO_DRYING_RACK_EXCLUSIVE_MODEL_V5DOT0DOT4_2024_0725
    config NORMAL_CTC_SCORE
      default y

    config KWS_MODEL_SUPPORT_SOFTMAX
      default y
    # Byte
    config KWS_SNPU_BUFFER_SIZE
        default 6028

    # Frames
    config KWS_MODEL_FEATURES_DIM_PER_FRAME
        default 40

    config KWS_MODEL_INPUT_STRIDE_LENGTH
        default 6

    config KWS_MODEL_INPUT_WIN_LENGTH
        default 25

    config KWS_MODEL_OUTPUT_LENGTH
        default 191

    config KWS_MODEL_DECODER_STRIDE_LENGTH
        int "KWS Lantency (unit of Context)"
        default 1
        range 1 4

    config KWS_MODEL_DECODER_WIN_LENGTH
        int "KWS Model Decoder Window Length (unit of context)"
        default 25
endmenu
```
